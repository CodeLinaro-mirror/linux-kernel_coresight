## Documentation/devicetree/bindings/arm/arm,coresight-dummy.yaml
```yaml
# SPDX-License-Identifier: GPL-2.0-only or BSD-2-Clause
%YAML 1.2
---
$id: http://devicetree.org/schemas/arm/arm,coresight-dummy.yaml#
$schema: http://devicetree.org/meta-schemas/core.yaml#

title: ARM Coresight Dummy component

description: |
  Coresight Dummy Trace Module is for the specific devices that kernel
  don't have permission to access or configure, e.g., CoreSight TPDMs
  on Qualcomm platforms. So there need driver to register dummy devices
  as Coresight devices. It may also be used to define components that
  may not have any programming interfaces (e.g, static links), so that
  paths can be established in the driver. Provide Coresight API for
  dummy device operations, such as enabling and disabling dummy devices.
  Build the Coresight path for dummy sink or dummy source for debugging.

  The primary use case of the coresight dummy is to build path in kernel
  side for dummy sink and dummy source.

maintainers:
  - Mao Jinlong <quic_jinlmao@quicinc.com>
  - Tao Zhang <quic_taozha@quicinc.com>
  - Hao Zhang <quic_hazha@quicinc.com>
  - Yuanfang Zhang <quic_yuanfang@quicinc.com>

properties:
  compatible:
    items:
      - enum:
          - arm,coresight-dummy-sink
          - arm,coresight-dummy-source

  out-ports:
    $ref: /schemas/graph.yaml#/properties/ports

    properties:
      port:
        description: Output connection from the source to Coresight
          Trace bus.
        $ref: /schemas/graph.yaml#/properties/port

  in-ports:
    $ref: /schemas/graph.yaml#/properties/ports

    properties:
      port:
        description: Input connection from the Coresight Trace bus to
          dummy sink, such as Embedded USB debugger(EUD).
        $ref: /schemas/graph.yaml#/properties/port

required:
  - compatible

if:
  # If the compatible contains the below value
  properties:
    compatible:
      contains:
        const: arm,coresight-dummy-sink

then:
  required:
    - in-ports

else:
  required:
    - out-ports

additionalProperties: false

examples:
  # Minimum dummy sink definition. Dummy sink connect to coresight replicator.
  - |
    sink {
      compatible = "arm,coresight-dummy-sink";

      in-ports {
        port {
          eud_in_replicator_swao: endpoint {
            remote-endpoint = <&replicator_swao_out_eud>;
          };
        };
      };
    };

  # Minimum dummy source definition. Dummy source connect to coresight funnel.
  - |
    source {
      compatible = "arm,coresight-dummy-source";

      out-ports {
        port {
          dummy_riscv_out_funnel_swao: endpoint {
            remote-endpoint = <&funnel_swao_in_dummy_riscv>;
          };
        };
      };
    };

...
```

## Documentation/devicetree/bindings/arm/qcom,coresight-csr.yaml
```yaml
# SPDX-License-Identifier: GPL-2.0-only or BSD-2-Clause
# Copyright (c) 2023 Qualcomm Innovation Center, Inc. All rights reserved.
%YAML 1.2
---
$id: http://devicetree.org/schemas/arm/qcom,coresight-csr.yaml#
$schema: http://devicetree.org/meta-schemas/core.yaml#

title: CoreSight Slave Register - TPDA

description: |
  CoreSight Slave Register block hosts miscellaneous configuration registers.
  Those configuration registers can be used to control, various coresight
  configurations.

maintainers:
  - Mao Jinlong <quic_jinlmao@quicinc.com>
  - Hao Zhang <quic_hazha@quicinc.com>

properties:
  $nodename:
    pattern: "^csr(@[0-9a-f]+)$"
  compatible:
    items:
      - const: qcom,coresight-csr

  reg:
    minItems: 1
    maxItems: 2

  clocks:
    maxItems: 1

  clock-names:
    items:
      - const: apb_pclk

  # size cells and address cells required if assoc_device node present.
  "#size-cells":
    const: 0

  "#address-cells":
    const: 1

patternProperties:
  '^assoc_device@([0-9]+)$':
    type: object
    description:
      A assocated device child node which describes the required configs
      between this CSR and another hardware device. This device may be ETR or
      TPDM device.

    properties:
      reg:
        maxItems: 1

      arm,cs-dev-assoc:
        $ref: /schemas/types.yaml#/definitions/phandle
        description:
          defines a phandle reference to an associated CoreSight trace device.
          When the associated trace device is enabled, then the respective CSR
          will be enabled. If the associated device has not been registered
          then the node name will be stored as the assocated name for later
          resolution.

      qcom,cs-dev-type:
        $ref: /schemas/types.yaml#/definitions/uint32
        description:
          Device type of the Assocated device. Types are in coresight-csr-dt.h.

      qcom,csr-bytecntr-offset:
        $ref: /schemas/types.yaml#/definitions/uint32
        description:
          The ETR irqctrl register offset. If the assocated device is ETR
          device and there are more than one ETR devices, this property need
          to be added.

      interrupts:
        minItems: 1

      interrupt-names:
        minItems: 1

    required:
      - reg
      - qcom,cs-dev-type
      - qcom,cs-dev-assoc

required:
  - compatible
  - reg
  - clocks
  - clock-names

additionalProperties: false

examples:
  # minimum CSR definition.
  - |
    csr@10001000 {
      compatible = "qcom,coresight-csr";
      reg = <0 0x10001000 0 0x1000>;

      clocks = <&aoss_qmp>;
      clock-names = "apb_pclk";
    };
  # Assocated with ETR device
  - |
    #include <dt-bindings/arm/coresight-csr-dt.h>
    #include <dt-bindings/interrupt-controller/arm-gic.h>

    csr@10001000 {
      compatible = "qcom,coresight-csr";
      reg = <0 0x10001000 0 0x1000>;

      clocks = <&aoss_qmp>;
      clock-names = "apb_pclk";

      #address-cells = <1>;
      #size-cells = <0>;
      assoc_device@0 {
        reg = <0>;
        qcom,cs-dev-type = <CSR_ASSOC_DEV_ETR>;
        qcom,cs-dev-assoc = <&tmc_etr>;
        qcom,csr-bytecntr-offset = <0x6c>;
        interrupts = <GIC_SPI 270 IRQ_TYPE_EDGE_RISING>;
        interrupt-names = "byte-cntr-irq";
      };
    };
...
```

## Documentation/devicetree/bindings/arm/qcom,coresight-dummy.yaml
```yaml
# SPDX-License-Identifier: GPL-2.0-only or BSD-2-Clause
# Copyright (c) 2023 Qualcomm Innovation Center, Inc. All rights reserved.
%YAML 1.2
---
$id: http://devicetree.org/schemas/arm/qcom,coresight-dummy.yaml#
$schema: http://devicetree.org/meta-schemas/core.yaml#

title: QCOM Coresight Dummy component

description: |
  The Coresight Dummy component is for the specific devices that HLOS don't have
  permission to access or configure. Such as Coresight sink EUD, some TPDMs etc.
  So there need driver to register dummy devices as Coresight devices. Provide
  Coresight API for dummy device operations, such as enabling and disabling
  dummy devices. Build the Coresight path for dummy sink or dummy source for
  debugging.

  The primary use case of the coresight dummy is to build path for dummy sink or
  dummy source.

maintainers:
  - Mao Jinlong <quic_jinlmao@quicinc.com>
  - Tao Zhang <quic_taozha@quicinc.com>
  - Hao Zhang <quic_hazha@quicinc.com>

select:
  properties:
    compatible:
      contains:
        enum:
          - qcom,coresight-dummy
  required:
    - compatible

properties:
  $nodename:
    pattern: "^dummy_.*(sink|source)_[0-9]+.*$"
  compatible:
    items:
      - const: qcom,coresight-dummy

  qcom,dummy-sink:
    type: boolean
    description:
      Indicates that the type of this coresight node is dummy sink.

  qcom,dummy-source:
    type: boolean
    description:
      Indicates that the type of this coresight node is dummy source.

  out-ports:
    description: |
      Output connections from the dummy source to Coresight Trace bus.
    $ref: /schemas/graph.yaml#/properties/ports

    properties:
      port:
        description: Output connection from the dummy source to Coresight
            Trace bus.
        $ref: /schemas/graph.yaml#/properties/port

  in-ports:
    description: |
      Input connections from the CoreSight Trace bus to dummy sink.
    $ref: /schemas/graph.yaml#/properties/ports

    properties:
      port:
        description: Input connection from the Coresight Trace bus to
            dummy sink.
        $ref: /schemas/graph.yaml#/properties/port

required:
  - compatible

additionalProperties: false

oneOf:
  - required:
      - qcom,dummy-sink
  - required:
      - qcom,dummy-source

examples:
  # minimum dummy sink definition. dummy sink connect to coresight replicator.
  - |
    dummy_sink_1 {
      compatible = "qcom,coresight-dummy";
      qcom,dummy-sink;

      in-ports {
        port {
          eud_in_replicator_swao: endpoint {
            remote-endpoint =
              <&replicator_swao_out_eud>;
          };
        };
      };
    };

  # minimum dummy source definition. dummy source connect to coresight funnel.
  - |
    dummy_source_1 {
      compatible = "qcom,coresight-dummy";
      qcom,dummy-source;

      out-ports {
        port {
          dummy_riscv_out_funnel_swao: endpoint {
            remote-endpoint =
              <&funnel_swao_in_dummy_riscv>;
          };
        };
      };
    };

...
```
